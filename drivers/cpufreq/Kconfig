## drivers/cpufreq/Kconfig
```kconfig
config CPU_FREQ
	bool "CPU Frequency scaling"
	help
	  CPU Frequency scaling allows you to change the clock speed of 
	  CPUs on the fly. This is a nice method to save power, because 
	  the lower the CPU clock speed, the less power the CPU consumes.
	  Note that this driver doesn't automatically change the CPU
	  clock speed, you need to either enable a dynamic cpufreq governor
	  (see below) after boot, or use a userspace tool.
	  For details, take a look at <file:Documentation/cpu-freq>.
	  If in doubt, say N.

if CPU_FREQ

config CPU_FREQ_TABLE
	tristate

config CPU_FREQ_DEBUG
	bool "Enable CPUfreq debugging"
	help
	  Say Y here to enable CPUfreq subsystem (including drivers)
	  debugging. You will need to activate it via the kernel
	  command line by passing
	     cpufreq.debug=<value>
	  To get <value>, add 
	       1 to activate CPUfreq core debugging,
	       2 to activate CPUfreq drivers debugging, and
	       4 to activate CPUfreq governor debugging

config CPU_FREQ_STAT
	tristate "CPU frequency translation statistics"
	select CPU_FREQ_TABLE
	default y
	help
	  This driver exports CPU frequency statistics information through sysfs
	  file system.
	  To compile this driver as a module, choose M here: the
	  module will be called cpufreq_stats.
	  If in doubt, say N.

config CPU_FREQ_STAT_DETAILS
	bool "CPU frequency translation statistics details"
	depends on CPU_FREQ_STAT
	help
	  This will show detail CPU frequency translation table in sysfs file
	  system.
	  If in doubt, say N.

choice
	prompt "Default CPUFreq governor"
	default CPU_FREQ_DEFAULT_GOV_USERSPACE if CPU_FREQ_SA1100 || CPU_FREQ_SA1110
	default CPU_FREQ_DEFAULT_GOV_PERFORMANCE
	help
	  This option sets which CPUFreq governor shall be loaded at
	  startup. If in doubt, select 'performance'.

config CPU_FREQ_DEFAULT_GOV_PERFORMANCE
	bool "performance"
	select CPU_FREQ_GOV_PERFORMANCE
	help
	  Use the CPUFreq governor 'performance' as default. This sets
	  the frequency statically to the highest frequency supported by
	  the CPU.

config CPU_FREQ_DEFAULT_GOV_POWERSAVE
	bool "powersave"
	depends on EMBEDDED
	select CPU_FREQ_GOV_POWERSAVE
	help
	  Use the CPUFreq governor 'powersave' as default. This sets
	  the frequency statically to the lowest frequency supported by
	  the CPU.

config CPU_FREQ_DEFAULT_GOV_USERSPACE
	bool "userspace"
	select CPU_FREQ_GOV_USERSPACE
	help
	  Use the CPUFreq governor 'userspace' as default. This allows
	  you to set the CPU frequency manually or when a userspace 
	  program shall be able to set the CPU dynamically without having
	  to enable the userspace governor manually.

config CPU_FREQ_DEFAULT_GOV_ONDEMAND
	bool "ondemand"
	select CPU_FREQ_GOV_ONDEMAND
	select CPU_FREQ_GOV_PERFORMANCE
	help
	  Use the CPUFreq governor 'ondemand' as default. This allows
	  you to get a full dynamic frequency capable system by simply
	  loading your cpufreq low-level hardware driver.
	  Be aware that not all cpufreq drivers support the ondemand
	  governor. If unsure have a look at the help section of the
	  driver. Fallback governor will be the performance governor.

config CPU_FREQ_DEFAULT_GOV_CONSERVATIVE
	bool "conservative"
	select CPU_FREQ_GOV_CONSERVATIVE
	select CPU_FREQ_GOV_PERFORMANCE
	help
	  Use the CPUFreq governor 'conservative' as default. This allows
	  you to get a full dynamic frequency capable system by simply
	  loading your cpufreq low-level hardware driver.
	  Be aware that not all cpufreq drivers support the conservative
	  governor. If unsure have a look at the help section of the
	  driver. Fallback governor will be the performance governor.

config CPU_FREQ_DEFAULT_GOV_SMARTASS
	bool "smartass"
	select CPU_FREQ_GOV_SMARTASS
	select CPU_FREQ_GOV_PERFORMANCE
	help
		Use the CPUFreq Governor 'smartass' as default.

config CPU_FREQ_DEFAULT_GOV_SMARTASS2
	bool "smartass2"
	select CPU_FREQ_GOV_SMARTASS2
	help
		Use the CPUFreq governor 'smartassV2' as default.

config CPU_FREQ_DEFAULT_GOV_SMARTASSH3
	bool "smartassH3"
	select CPU_FREQ_GOV_SMARTASSH3
	help
		Use the CPUFreq governor 'SmartassH3' as default.
		
config CPU_FREQ_DEFAULT_GOV_ZENX
	bool "ZenX"
	select CPU_FREQ_GOV_ZENX
	help
	Use the CPUFreq governor 'ZenX' as default.

config CPU_FREQ_DEFAULT_GOV_PEGASUSQ
	bool "pegasusq"
	select CPU_FREQ_GOV_PEGASUSQ	

config CPU_FREQ_DEFAULT_GOV_INTERACTIVE
  	bool "interactive"
	select CPU_FREQ_GOV_INTERACTIVE
	help
	  Use the 'interactive' governor as default. This gets full cpu frequency
	  scaling for workloads that are latency sensitive, typically interactive
	  workloads..

config CPU_FREQ_DEFAULT_GOV_INTERACTIVEX
	bool "interactiveX"
	select CPU_FREQ_GOV_INTERACTIVEX
	help
	  Use the CPUFreq governor 'interactiveX' as default. This allows
	  you to get a full dynamic cpu frequency capable system by simply
	  loading your cpufreq low-level hardware driver, using the
	  'interactiveX' governor for latency-sensitive workloads.

config CPU_FREQ_DEFAULT_GOV_SAVAGEDZEN
	bool "SavagedZen"
	select CPU_FREQ_GOV_SAVAGEDZEN
	help
	  Use the CPUFreq governor 'savagedzen' as default.

config CPU_FREQ_DEFAULT_GOV_SCARY
	bool "scary"
	select CPU_FREQ_GOV_SCARY
	help
		Use the CPUFreq governor 'scary' as default.

config CPU_FREQ_DEFAULT_GOV_MINMAX
	bool "minmax"
	select CPU_FREQ_GOV_MINMAX
	select CPU_FREQ_GOV_PERFORMANCE
	help
	  Use the CPUFreq governor 'minmax' as default. This minimizes the
	  frequency jumps does by the governor. This is aimed at maximizing
	  both perfomance and battery life.

config CPU_FREQ_DEFAULT_GOV_LULZACTIVE
	bool "lulzactive"
	select CPU_FREQ_GOV_LULZACTIVE
	select CPU_FREQ_GOV_PERFORMANCE
	help
	  Use the CPUFreq governor 'lulzactive' as default.

config CPU_FREQ_DEFAULT_GOV_LAGFREE
        bool "lagfree"
        select CPU_FREQ_GOV_LAGFREE
        select CPU_FREQ_GOV_PERFORMANCE
        help
          Use the CPUFreq governor 'lagfree' as default. This allows
          you to get a full dynamic frequency capable system by simply
          loading your cpufreq low-level hardware driver.
          Be aware that not all cpufreq drivers support the lagfree
          governor. If unsure have a look at the help section of the
          driver. Fallback governor will be the performance governor.

config CPU_FREQ_DEFAULT_GOV_ONDEMANDX
  	bool "ondemandx"
  	select CPU_FREQ_GOV_ONDEMANDX
  	select CPU_FREQ_GOV_PERFORMANCE
  	help
    	  Use the CPUFreq governor 'ondemand' as default. This allows
    	  you to get a full dynamic frequency capable system by simply
		  loading your cpufreq low-level hardware driver.
    	  Be aware that not all cpufreq drivers support the ondemand
    	  governor. If unsure have a look at the help section of the
    	  driver. Fallback governor will be the performance governor.
    	  OndemandX has built in sleep profile, but not working Sysfs
    	  interface

config CPU_FREQ_DEFAULT_GOV_LAZY
        bool "lazy"
        select CPU_FREQ_GOV_LAZY
        select CPU_FREQ_GOV_PERFORMANCE
        help
          Use the CPUFreq governor 'lazy' as default.
		  
config CPU_FREQ_DEFAULT_GOV_GALAXYICS
		bool "galaxyics"
		select CPU_FREQ_GOV_GALAXYICS
		help
		Use the CPUFreq governor 'galaxyics' as default. This allows
		you to get a full dynamic cpu frequency capable system by simply
		loading your cpufreq low-level hardware driver, using the
		'galaxyics' governor optimized for GalaxyICS devices.
		
config CPU_FREQ_DEFAULT_GOV_BADASS
		bool "badass"
		select CPU_FREQ_GOV_BADASS
		select CPU_FREQ_GOV_PERFORMANCE
		help
		Use the CPUFreq governor 'badass' as default. This allows
		you to get a full dynamic frequency capable system by simply
		loading your cpufreq low-level hardware driver.
		Be aware that not all cpufreq drivers support the badass
		governor. If unsure have a look at the help section of the
		driver. Fallback governor will be the performance governor. 		

endchoice

config CPU_FREQ_GOV_PERFORMANCE
	tristate "'performance' governor"
	help
	  This cpufreq governor sets the frequency statically to the
	  highest available CPU frequency.
	  To compile this driver as a module, choose M here: the
	  module will be called cpufreq_performance.
	  If in doubt, say Y.

config CPU_FREQ_GOV_POWERSAVE
	tristate "'powersave' governor"
	help
	  This cpufreq governor sets the frequency statically to the
	  lowest available CPU frequency.
	  To compile this driver as a module, choose M here: the
	  module will be called cpufreq_powersave.
	  If in doubt, say Y.

config CPU_FREQ_GOV_USERSPACE
	tristate "'userspace' governor for userspace frequency scaling"
	help
	  Enable this cpufreq governor when you either want to set the
	  CPU frequency manually or when a userspace program shall
	  be able to set the CPU dynamically, like on LART 
	  <http://www.lartmaker.nl/>.
	  To compile this driver as a module, choose M here: the
	  module will be called cpufreq_userspace.
	  For details, take a look at <file:Documentation/cpu-freq/>.
	  If in doubt, say Y.

config CPU_FREQ_GOV_ONDEMAND
	tristate "'ondemand' cpufreq policy governor"
	select CPU_FREQ_TABLE
	help
	  'ondemand' - This driver adds a dynamic cpufreq policy governor.
	  The governor does a periodic polling and 
	  changes frequency based on the CPU utilization.
	  The support for this governor depends on CPU capability to
	  do fast frequency switching (i.e, very low latency frequency
	  transitions). 
	  To compile this driver as a module, choose M here: the
	  module will be called cpufreq_ondemand.
	  For details, take a look at linux/Documentation/cpu-freq.
	  If in doubt, say N.

config CPU_FREQ_GOV_CONSERVATIVE
	tristate "'conservative' cpufreq governor"
	depends on CPU_FREQ
	help
	  'conservative' - this driver is rather similar to the 'ondemand'
	  governor both in its source code and its purpose, the difference is
	  its optimisation for better suitability in a battery powered
	  environment.  The frequency is gracefully increased and decreased
	  rather than jumping to 100% when speed is required.
	  If you have a desktop machine then you should really be considering
	  the 'ondemand' governor instead, however if you are using a laptop,
	  PDA or even an AMD64 based computer (due to the unacceptable
	  step-by-step latency issues between the minimum and maximum frequency
	  transitions in the CPU) you will probably want to use this governor.
	  To compile this driver as a module, choose M here: the
	  module will be called cpufreq_conservative.
	  For details, take a look at linux/Documentation/cpu-freq.
	  If in doubt, say N.

config CPU_FREQ_GOV_SMARTASS2
	tristate "'smartassV2' cpufreq governor"
	depends on CPU_FREQ
	help
		'smartassV2' - a "smart" governor
		If in doubt, say N.

config CPU_FREQ_GOV_SMARTASSH3
	tristate "'SmartassH3' cpufreq governor"
	depends on CPU_FREQ
	help
		'SmartassH3' - a "smartassV2 with tweaks by H3ROS" governor.
		If in doubt, say N.

config CPU_FREQ_GOV_ZENX
	tristate "'ZenX' cpufreq governor"
	depends on CPU_FREQ
	help
		'ZenX' - an interactive-based governor
		This governor provides full CPU hotplugging support
		based on average CPU load across all CPUs.
		For details, take a look at linux/Documentation/cpu-freq.
		If in doubt, say N

config CPU_FREQ_GOV_PEGASUSQ
	tristate "'pegasusq' cpufreq policy governor"		
		
config CPU_FREQ_GOV_INTERACTIVE
	tristate "'interactive' cpufreq policy governor"
	depends on CPU_FREQ
	help
	  'interactive' - This driver adds a dynamic cpufreq policy governor.
	  Designed for low latency burst workloads. Scaling it done when coming
	  out of idle instead of polling.

config CPU_FREQ_GOV_INTERACTIVEX
	tristate "'interactiveX' cpufreq policy governor"	
	help	
	  'interactiveX' - Modified version of interactive with sleep+wake code.

config CPU_FREQ_GOV_SAVAGEDZEN
	tristate "'savagedzen' cpufreq governor"
	depends on CPU_FREQ
	help
	   'Savaged-Zen' - a "smartass" based governor
	   If in doubt, say N.

config CPU_FREQ_GOV_SCARY
	tristate "'scary' cpufreq governor"
	depends on CPU_FREQ
	help
		scary - a governor for cabbages
		If in doubt, say N.

config CPU_FREQ_GOV_SMARTASS
	tristate "'smartass' cpufreq governor"
	depends on CPU_FREQ
	help
		'smartass' - a "smart" optimized governors

config CPU_FREQ_GOV_MINMAX
	tristate "'minmax' cpufreq governor"
	depends on CPU_FREQ
	help
	  'minmax' - this driver tries to minimize the frequency jumps by limiting
	  the the selected frequencies to either the min or the max frequency of
	  the policy. The frequency is selected according to the load.
	  If in doubt, say N.

config CPU_FREQ_GOV_LULZACTIVE
	tristate "'lulzactive' cpufreq governor"
	depends on CPU_FREQ
	help
	   'lulzactive' - a new interactive governor by Tegrak!

config CPU_FREQ_GOV_LAGFREE
        tristate "'lagfree' cpufreq governor"
        depends on CPU_FREQ
        help
          'lagfree' - this driver is rather similar to the 'ondemand'
          governor both in its source code and its purpose, the difference is
          its optimisation for better suitability in a battery powered
          environment.  The frequency is gracefully increased and decreased
          rather than jumping to 100% when speed is required.
          To compile this driver as a module, choose M here: the
          module will be called cpufreq_lagfree.
          For details, take a look at linux/Documentation/cpu-freq.
          If in doubt, say N.

config CPU_FREQ_GOV_ONDEMANDX
  	tristate "'ondemandx' cpufreq policy governor"
  	select CPU_FREQ_TABLE
  	help
  	  'ondemand' - This driver adds a dynamic cpufreq policy governor.
  	  The governor does a periodic polling and
 	  changes frequency based on the CPU utilization.
  	  The support for this governor depends on CPU capability to
  	  do fast frequency switching (i.e, very low latency frequency
  	  transitions).
  	  To compile this driver as a module, choose M here: the
  	  module will be called cpufreq_ondemand.
  	  For details, take a look at linux/Documentation/cpu-freq.
  	  If in doubt, say N.

config CPU_FREQ_GOV_ONDEMANDX_INPUT
 	 bool "Ramp up CPU frequency on input events"
	 default y
 	 depends on CPU_FREQ_GOV_ONDEMANDX
 	 help
  	   Enable installation of an input event handler which will ramp up the
 	   CPU to max frequency when an input event is received.

config CPU_FREQ_GOV_LAZY
        tristate "'lazy' cpufreq governor"
        depends on CPU_FREQ

config CPU_FREQ_MIN_TICKS
	int "Ticks between governor polling interval."
	default 10
	help
		Minimum number of ticks between polling interval for governors.

config CPU_FREQ_SAMPLING_LATENCY_MULTIPLIER
	int "Sampling rate multiplier for governors."
	default 1000
	help
		Sampling latency rate multiplied by the cpu switch latency.
		Affects governor polling.
	  
config CPU_FREQ_GOV_GALAXYICS
	tristate "'galaxyics' cpufreq governor"
	help
		'galaxyics' - This driver adds a dynamic cpufreq policy governor
		optimized for GalaxyICS devices.
		To compile this driver as a module, choose M here: the
		module will be called cpufreq_galaxyics.
		For details, take a look at linux/Documentation/cpu-freq.
		If in doubt, say N.
		
config CPU_FREQ_GOV_BADASS
	tristate "'badass' cpufreq policy governor"
	select CPU_FREQ_TABLE
		help
		'badass' - This driver adds a dynamic cpufreq policy governor.
		The governor does a periodic polling and
		changes frequency based on the CPU utilization.
		The support for this governor depends on CPU capability to
		do fast frequency switching (i.e, very low latency frequency
		transitions).
		To compile this driver as a module, choose M here: the
		module will be called cpufreq_badass.
		If in doubt, say N.

config CPU_FREQ_GOV_BADASS_2_PHASE
	tristate "'2-phase' power-efficiency badass algorithm"
	depends on CPU_FREQ_GOV_BADASS
	help
	  '2-phase' - This driver adds a new algo to save power

config CPU_FREQ_GOV_BADASS_2_PHASE_FREQ
	int "'2-phase' badass frequency"
	default 768000
	depends on CPU_FREQ_GOV_BADASS
	depends on CPU_FREQ_GOV_BADASS_2_PHASE

config CPU_FREQ_GOV_BADASS_3_PHASE
	tristate "'3-phase' power-efficiency badass algorithm"
	depends on CPU_FREQ_GOV_BADASS
	depends on CPU_FREQ_GOV_BADASS_2_PHASE
	help
	  '3-phase' - This driver adds a new algo to save power

config CPU_FREQ_GOV_BADASS_3_PHASE_FREQ
	int "'3-phase' badass frequency"
	default 825000
	depends on CPU_FREQ_GOV_BADASS
	depends on CPU_FREQ_GOV_BADASS_2_PHASE
	depends on CPU_FREQ_GOV_BADASS_3_PHASE

config CPU_FREQ_GOV_BADASS_GPU_CONTROL
	tristate "'gpu_control' power-efficiency badass algorithm"
	depends on CPU_FREQ_GOV_BADASS
	depends on CPU_FREQ_GOV_BADASS_2_PHASE
	help
	  'gpu_control' - This driver adds a new algo to save power

config CPU_FREQ_GOV_BADASS_LOWBAT_POWERSAVE
	tristate "'lowbat_powersave' power-efficiency badass algorithm"
	depends on CPU_FREQ_GOV_BADASS
	help
	  'lowbat_powersave' - This driver adds a new algo to save power

config CPU_FREQ_GOV_BADASS_ALLOW_BYPASS
	tristate "Allows bypassing phases"
	depends on CPU_FREQ_GOV_BADASS
	depends on CPU_FREQ_GOV_BADASS_2_PHASE
	help
	  'allow_bypass' - This driver adds a bypass to the phases
		

endif	# CPU_FREQ
```
