## drivers/i2c/chips/Kconfig
```kconfig
#
# Miscellaneous I2C chip drivers configuration
#
# *** DEPRECATED! Do not add new entries! See Makefile ***
#

menu "Miscellaneous I2C Chip support"

config SENSORS_MT9T013
	tristate "MT9T013 Camera Driver"
	depends on I2C
	default n
	help
	 MT9T013 Camera Driver implemented by HTC.

config AMP_MAX97000
	bool "Maxim MAX97000 Amp Subsystem Driver"
	depends on I2C 
	default n

config FSA9280
	bool "Fairchild FSA9280 USB switch Driver"
	depends on I2C
	default y

config SENSORS_BMA_ACCEL
	tristate "BMA acceleration sensor support"
	depends on I2C=y
	default n
	help
	  If you say yes here you get support for Bosch Sensortec's 
	  acceleration sensors BMA.

config SENSORS_KR3D_ACCEL
	tristate "KR3Dx acceleration sensor support"
	depends on I2C=y
	default n
	help
	  If you say yes here you get support for STMicro's 
	  acceleration sensors KR3Dx.

config SENSORS_MMC31XX
	tristate "MEMSIC Magnetic Sensor Driver Support"
	depends on I2C
	default n
	help
	  If you say yes here you get support for the MEMSIC magnateic sensor	  

config ECOMPASS
	tristate "MEMSIC eCompass Sensor Driver Support"
	depends on I2C
	default n
	help
	  If you say yes here you get support for the MEMSIC magnateic sensor

config SENSORS_GP2A
	tristate "GP2A sensor support"
	depends on I2C=y
	default n
	help
	  If you say yes here you get support for Sharp's sensor GP2A.

config SENSORS_TAOS
	tristate "TAOS sensor support"
	depends on I2C=y
	default n
	help
	  If you say yes here you get support for TAOS's proximity sensor.

endmenu
```

## drivers/tfsr/Kconfig
```kconfig
#
# Unified Flash Device configuration
#

menu "TinyFSR Support for cramfs"

config TINY_FSR
	bool "Using TinyFSR for Cramfs"
	default y
	help
	  eXtended Sector Remapper device

config TINY_FLASH_PHYS_ADDR
        hex "Flex-OneNAND flash Physical Location"
        depends on TINY_FSR
        default "0x00100000"
        help
          This is the physical address in your flash memory the fsr will
          be linked for and stored to.  This address is dependent on your
          own flash usage.

config LINUSTOREIII_TINY_DEBUG_VERBOSE
	int "LinuStoreIII Tiny Debugging verbosity (0 = quiet, 3 = noisy)"
	depends on TINY_FSR
	default 0

endmenu
```

## drivers/uvbeni/Kconfig
```kconfig
#
# beniuv module configuration
#

config BENI_UNDERVOLT
	tristate "Beni undervolt"
	help
	  Say Y here if you want to build an undervolt module for Beni

	  If unsure, say N.

	  To compile this module, choose M here: the
	  module will be called Beniuv.
```

## drivers/uvcooper/Kconfig
```kconfig
#
# cooperuv module configuration
#

config COOPER_UNDERVOLT
	tristate "Cooper undervolt"
	help
	  Say Y here if you want to build an undervolt module for Cooper

	  If unsure, say N.

	  To compile this module, choose M here: the
	  module will be called Cooperuv.
```

## drivers/uvgio/Kconfig
```kconfig
#
# giouv module configuration
#

config GIO_UNDERVOLT
	tristate "Gio undervolt"
	help
	  Say Y here if you want to build an undervolt module for Gio

	  If unsure, say N.

	  To compile this module, choose M here: the
	  module will be called Giouv.
```
